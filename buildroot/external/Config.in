## buildroot/external/package/fx-pwm/Config.in
```kconfig
config BR2_PACKAGE_FX_PWM
	bool "fx-pwm"
	help
	  Userspace driver for the Ingenic X2600 PWM2 block (the AD5X piezo
	  buzzer on pc12) through the ioctl ABI of the stock soc_pwm.ko
	  kernel module (/dev/jz_pwm).

	  The stock firmware beeps by calling its own cmd_pwm tool from the
	  OEM rootfs, which the Forge-X chroot replaces - this package ships
	  the replacement so the buzzer keeps working inside the chroot.
```

## buildroot/external/package/python-importlib-metadata/Config.in
```kconfig
config BR2_PACKAGE_PYTHON_IMPORTLIB_METADATA
	bool "python-importlib-metadata"
	select BR2_PACKAGE_PYTHON_ZIPP # runtime
	help
	  Library to access the metadata for a Python package.

	  https://github.com/python/importlib_metadata
```

## buildroot/external/package/python-inotify-simple/Config.in
```kconfig
config BR2_PACKAGE_PYTHON_INOTIFY_SIMPLE
	bool "python-inotify-simple"
	help
	  A simple Python wrapper around inotify. No fancy bells and
	  whistles, just a literal wrapper with ctypes.

	  https://github.com/chrisjbillington/inotify_simple
```

## buildroot/external/package/python-libnacl/Config.in
```kconfig
config BR2_PACKAGE_PYTHON_LIBNACL
	bool "python-libnacl"
	select BR2_PACKAGE_LIBSODIUM
	help
	  Python bindings for libsodium based on ctypes.

	  The bindings are pure Python and dlopen() libsodium at
	  runtime, so libsodium must be present on the target.

	  https://github.com/saltstack/libnacl
```

## buildroot/external/package/python-preprocess-cancellation/Config.in
```kconfig
config BR2_PACKAGE_PYTHON_PREPROCESS_CANCELLATION
	bool "python-preprocess-cancellation"
	help
	  GCode processor that adds Klipper cancel-object markers.

	  https://github.com/kageurufu/cancelobject-preprocessor
```

## buildroot/external/package/python-smart-open/Config.in
```kconfig
config BR2_PACKAGE_PYTHON_SMART_OPEN
	bool "python-smart-open"
	select BR2_PACKAGE_PYTHON_WRAPT # runtime
	help
	  Utils for streaming large files (S3, HDFS, GCS, Azure Blob
	  Storage, gzip, bz2...).

	  https://github.com/piskvorky/smart_open
```

## buildroot/external/package/python-streaming-form-data/Config.in
```kconfig
config BR2_PACKAGE_PYTHON_STREAMING_FORM_DATA
	bool "python-streaming-form-data"
	select BR2_PACKAGE_PYTHON_SMART_OPEN # runtime
	help
	  Streaming parser for multipart/form-data.

	  The sdist ships the pre-generated _parser.c, so only a C
	  compiler is needed, not Cython.

	  https://github.com/siddhantgoel/streaming-form-data
```
